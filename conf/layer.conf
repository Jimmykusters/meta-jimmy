## conf/layer.conf
```bitbake
# We have a conf and classes directory, add to BBPATH
BBPATH .= ":${LAYERDIR}"

# We have recipes-* directories, add to BBFILES
BBFILES += "${LAYERDIR}/recipes-*/*/*.bb \
            ${LAYERDIR}/recipes-*/*/*.bbappend"

BBFILE_COLLECTIONS += "meta-jimmy"
BBFILE_PATTERN_meta-jimmy = "^${LAYERDIR}/"
BBFILE_PRIORITY_meta-jimmy = "6"

LAYERDEPENDS_meta-jimmy = "core"
LAYERSERIES_COMPAT_meta-jimmy = "dunfell"
```
